/ {
    ws2812: ws2812 {
        compatible = "zmk,ws2812-spi";
        label = "WS2812";

        /* El pin del data de tu PCB - usa el correcto */
        chain-length = <35>;
        spi-max-frequency = <4000000>;
        reg = <0>;
    };

    leds: leds {
        compatible = "zmk,underglow";

        /* LEDS GRANDES – orden físico real */
        led0  = <&ws2812 0>;   /* D01 */
        led1  = <&ws2812 1>;   /* D02 */
        led2  = <&ws2812 2>;   /* D03 */
        led3  = <&ws2812 3>;   /* D06 */
        led4  = <&ws2812 4>;   /* D04 */
        led5  = <&ws2812 5>;   /* D05 */

        /* SWITCH LEDS – orden serpenteante real */
        led6  = <&ws2812 6>;   /* S7 */
        led7  = <&ws2812 7>;   /* S8 */
        led8  = <&ws2812 8>;   /* S9 */
        led9  = <&ws2812 9>;   /* S10 */
        led10 = <&ws2812 10>;  /* S11 */
        led11 = <&ws2812 11>;  /* S12 */

        led12 = <&ws2812 12>;  /* S18 */
        led13 = <&ws2812 13>;  /* S17 */
        led14 = <&ws2812 14>;  /* S16 */
        led15 = <&ws2812 15>;  /* S15 */
        led16 = <&ws2812 16>;  /* S14 */
        led17 = <&ws2812 17>;  /* S13 */

        led18 = <&ws2812 18>;  /* S19 */
        led19 = <&ws2812 19>;  /* S20 */
        led20 = <&ws2812 20>;  /* S21 */
        led21 = <&ws2812 21>;  /* S22 */
        led22 = <&ws2812 22>;  /* S23 */
        led23 = <&ws2812 23>;  /* S24 */

        led24 = <&ws2812 24>;  /* S35 */
        led25 = <&ws2812 25>;  /* S30 */
        led26 = <&ws2812 26>;  /* S29 */
        led27 = <&ws2812 27>;  /* S28 */
        led28 = <&ws2812 28>;  /* S27 */
        led29 = <&ws2812 29>;  /* S26 */
        led30 = <&ws2812 30>;  /* S25 */

        led31 = <&ws2812 31>;  /* S31 */
        led32 = <&ws2812 32>;  /* S32 */
        led33 = <&ws2812 33>;  /* S33 */
        led34 = <&ws2812 34>;  /* S34 */
    };
};
